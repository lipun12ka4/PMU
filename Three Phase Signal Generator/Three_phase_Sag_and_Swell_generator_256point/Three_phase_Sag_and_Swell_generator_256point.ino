#include <JeeLib.h>
#include <avr/pgmspace.h>
#include <TimerOne.h>

//byte index;
int i=0;

byte sineR256[] PROGMEM = {100,102,105,107,110,112,115,117,120,122,124,127,129,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95,98};
byte sineY256[] PROGMEM = {199,199,199,198,198,197,196,196,195,194,193,192,191,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200,200};
byte sineB256[] PROGMEM = {26,24,23,21,20,18,17,16,14,13,12,11,10,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29,28};

byte SaggedsineR256[] PROGMEM = {85,86,89,90,93,95,97,99,102,103,105,107,109,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80,83};
byte SaggedsineY256[] PROGMEM = {169,169,169,168,168,167,166,166,165,164,164,163,162,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170,170};
byte SaggedsineB256[] PROGMEM = {22,20,19,17,17,15,14,13,11,11,10,9,8,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24,23};

byte SwelledsineR256[] PROGMEM = {115,117,120,123,126,128,132,134,138,140,142,146,148,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109,112};
byte SwelledsineY256[] PROGMEM = {228,228,228,227,227,226,225,225,224,223,221,220,219,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230,230};
byte SwelledsineB256[] PROGMEM = {29,27,26,24,23,20,19,18,16,14,13,12,11,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33,32};

int interval=77;

void setup () {
  Serial.begin(115200);
  for(int i=22;i<50;i++)//Define Port A,C and L as Output
  {
    pinMode(i,OUTPUT);
  }
  print_tables();
}
void print_tables(){
  
  Serial.println("Red Phase   "); 
  for (int i=0;i<256;i++) {

    Serial.print(pgm_read_byte(sineR256 + i));//Red Phase
    Serial.print(",");
  }
  Serial.println();
  Serial.println("Yellow Phase ");
  for (int i=0;i<256;i++) {        

    Serial.print(pgm_read_byte(sineY256 + i));//Red Phase
    Serial.print(",");
  }
  Serial.println();
  Serial.println("Blue Phase  ");
  for (int i=0;i<256;i++) {

    Serial.print(pgm_read_byte(sineB256 + i));//Red Phase
    Serial.print(",");
  }
  Serial.println();
  Serial.println();
  
  Serial.println("Sagged Red Phase   "); 
  for (int i=0;i<256;i++) {

    Serial.print(int(pgm_read_byte(sineR256 + i)*.85));//Red Phase
    Serial.print(",");
  }
  Serial.println();
  Serial.println("Sagged Yellow Phase ");
  for (int i=0;i<256;i++) {        

    Serial.print(int(pgm_read_byte(sineY256 + i)*.85));//Red Phase
    Serial.print(",");
  }
  Serial.println();
  Serial.println("Sagged Blue Phase  ");
  for (int i=0;i<256;i++) {

    Serial.print(int(pgm_read_byte(sineB256 + i)*.85));//Red Phase
    Serial.print(",");
  }
  Serial.println();
  Serial.println();
  
    Serial.println("Swelled Red Phase   "); 
  for (int i=0;i<256;i++) {

    Serial.print(int(pgm_read_byte(sineR256 + i)*1.15));//Red Phase
    Serial.print(",");
  }
  Serial.println();
  Serial.println("Swelled Yellow Phase ");
  for (int i=0;i<256;i++) {        

    Serial.print(int(pgm_read_byte(sineY256 + i)*1.15));//Red Phase
    Serial.print(",");
  }
  Serial.println();
  Serial.println("Swelled Blue Phase  ");
  for (int i=0;i<256;i++) {

    Serial.print(int(pgm_read_byte(sineB256 + i)*1.15));//Red Phase
    Serial.print(",");
  }
  Serial.println();
  Serial.println();
}
void loop () {
//while(1);
for(int i=0;i<200;i++)
{
for (int i=0;i<256;i++) {

        PORTA = pgm_read_byte(sineR256 + i);//Red Phase
        PORTC = pgm_read_byte(sineY256 + i);//Blue Phase
        PORTL = pgm_read_byte(sineB256 + i);//Yellow Phase

        delayMicroseconds(interval);
        
    }
}
for(int i=0;i<10;i++)//Sagged
{
for (int i=0;i<256;i++) {

        PORTA = pgm_read_byte(SaggedsineR256 + i);//Red Phase
        PORTC = pgm_read_byte(SaggedsineY256 + i);//Blue Phase
        PORTL = pgm_read_byte(SaggedsineB256 + i);//Yellow Phase

        delayMicroseconds(interval);
        
    }
}
for(int i=0;i<100;i++)//Normal
{
for (int i=0;i<256;i++) {

        PORTA = pgm_read_byte(sineR256 + i);//Red Phase
        PORTC = pgm_read_byte(sineY256 + i);//Blue Phase
        PORTL = pgm_read_byte(sineB256 + i);//Yellow Phase

        delayMicroseconds(interval);
        
    }
}


for(int i=0;i<20;i++)//Swelled Signals
{
for (int i=0;i<256;i++) {

        PORTA = pgm_read_byte(SwelledsineR256 + i);//Red Phase
        PORTC = pgm_read_byte(SwelledsineY256 + i);//Blue Phase
        PORTL = pgm_read_byte(SwelledsineB256 + i);//Yellow Phase

        delayMicroseconds(interval);
        
    }
}


}









